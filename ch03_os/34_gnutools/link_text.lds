SECTIONS {
         .text : {
                /* リンク時の入力ファイル(*=ワイルドカードで全マッチなので全ファイル)にある
                 * .textセクションをリンク後のファイルの.textセクションに入れる */
               *(.text)
         }

         /DISCARD/ : { *(*) } /* リンクしなかった全セクションを破棄 */
}
